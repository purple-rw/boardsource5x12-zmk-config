## config/boards/shields/boardsource5x12/Kconfig.defconfig
```kconfig
# Copyright (c) 2021 purple-rw
# SPDX-License-Identifier: MIT

if SHIELD_BOARDSOURCE5X12

config ZMK_KEYBOARD_NAME
    default "Boardsource 5x12"

endif
```

## config/boards/shields/boardsource5x12/Kconfig.shield
```kconfig
# Copyright (c) 2021 purple-rw
# SPDX-License-Identifier: MIT

config SHIELD_BOARDSOURCE5X12
    def_bool $(shields_list_contains,boardsource5x12)
```
